## config/west.yml
```yaml
manifest:
  remotes:
    - name: zmkfirmware
      url-base: https://github.com/zmkfirmware
    - name: hyhy-masa
      url-base: https://github.com/hyhy-masa
    - name: caksoylar
      url-base: https://github.com/caksoylar
    - name: zzeneg
      url-base: https://github.com/zzeneg
    - name: srwi
      url-base: https://github.com/srwi
    - name: yangentai181-wq
      url-base: https://github.com/yangentai181-wq
    - name: kot149
      url-base: https://github.com/kot149
  projects:
    - name: zmk
      remote: hyhy-masa
      revision: 957c4b0c
      import: app/west.yml
    - name: zmk-raw-hid
      remote: zzeneg
      revision: e25e325adc90fccb60cc08393b8c2b0ba6d647c7
    - name: zmk-keypeek-layer-notifier
      remote: srwi
      revision: ad688638517baf527e66a20596aa152cb42a1cd4
    - name: zmk-input-notifier
      remote: yangentai181-wq
      revision: efa410ab535374e82d1e512bd832cb7e7dd9ff30
    - name: pmw3610-driver-minimal
      remote: yangentai181-wq
      revision: b882cd3d571b25cc9c1069c5a0f94a9961f1396b
      path: modules/pmw3610-driver-minimal
    - name: zmk-mouse-gesture
      remote: kot149
      revision: 62f3c9d8ca6763e160b73efc46108c61dd0243a0
    - name: zmk-rgbled-widget
      remote: caksoylar
      revision: e9472d6c
    - name: zmk-module-runtime-input-processor
      remote: hyhy-masa
      revision: 8103d061
    - name: zmk-module-ble-management
      remote: hyhy-masa
      revision: 851661cd
    - name: zmk-behavior-runtime-sensor-rotate
      remote: hyhy-masa
      revision: efed4f23
    - name: zmk-module-runtime-combos
      remote: hyhy-masa
      revision: 119de78
    - name: zmk-module-battery-history
      remote: hyhy-masa
      revision: 465e53e9
    - name: zmk-module-settings-rpc
      remote: hyhy-masa
      revision: ad1c995c
    - name: zmk-module-hold-tap-rpc
      remote: hyhy-masa
      revision: 2a352a2
  self:
    path: config
```

## dts/bindings/behaviors/minimal-keys,behavior-gesture-slot.yaml
```yaml
description: Invoke a binding in the reserved gesture layer by physical position

compatible: "minimal-keys,behavior-gesture-slot"

include: one_param.yaml
```
